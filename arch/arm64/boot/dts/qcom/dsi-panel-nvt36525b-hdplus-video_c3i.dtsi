/* Copyright (c) 2013, The Linux Foundation. All rights reserved.
 * Copyright (C) 2019 XiaoMi, Inc.
 *
 * This program is free software; you can redistribute it and/or modify
 * it under the terms of the GNU General Public License version 2 and
 * only version 2 as published by the Free Software Foundation.
 *
 * This program is distributed in the hope that it will be useful,
 * but WITHOUT ANY WARRANTY; without even the implied warranty of
 * MERCHANTABILITY or FITNESS FOR A PARTICULAR PURPOSE.  See the
 * GNU General Public License for more details.
 */

/*---------------------------------------------------------------------------
 * This file is autogenerated file using gcdb parser. Please do not edit it.
 * Update input XML file to add a new entry or update variable in this file
 * VERSION = "1.0"
 *---------------------------------------------------------------------------*/
&mdss_mdp {
	dsi_nvt36525b_hdplus_c3i_video: qcom,mdss_dsi_nvt36525b_hdplus_video_c3i {
		qcom,mdss-dsi-panel-name = "nvt36525b hdplus c3i video mode dsi panel";
		qcom,mdss-dsi-panel-controller = <&mdss_dsi0>;
		qcom,mdss-dsi-panel-type = "dsi_video_mode";
		qcom,mdss-dsi-panel-destination = "display_1";
		qcom,mdss-dsi-panel-framerate = <60>;
		qcom,mdss-dsi-virtual-channel-id = <0>;
		qcom,mdss-dsi-stream = <0>;
		qcom,mdss-dsi-panel-width = <720>;
		qcom,mdss-dsi-panel-height = <1520>;
		qcom,mdss-dsi-h-front-porch = <101>;
		qcom,mdss-dsi-h-back-porch = <100>;
		qcom,mdss-dsi-h-pulse-width = <8>;
		qcom,mdss-dsi-h-sync-skew = <0>;
		qcom,mdss-dsi-v-front-porch = <10>;
		qcom,mdss-dsi-v-back-porch = <8>;
		qcom,mdss-dsi-v-pulse-width = <2>;
		qcom,mdss-dsi-h-left-border = <0>;
		qcom,mdss-dsi-h-right-border = <0>;
		qcom,mdss-dsi-v-top-border = <0>;
		qcom,mdss-dsi-v-bottom-border = <0>;
		qcom,mdss-dsi-bpp = <24>;
		qcom,mdss-dsi-underflow-color = <0xff>;
		qcom,mdss-dsi-border-color = <0>;
		qcom,mdss-dsi-on-command = <0x29010000 0x2ff 0x20290100 0x02 0xfb013901 0x00 0x11c00203 0x506080d 0xd0e0f10 0x12403824 0x242c3901 0x00 0x11c20203 0x506080d 0xd0e0f10 0x12123824 0x242c2901 0x00 0x2ff2329 0x1000000 0x2fb01 0x29010000 0x200 0x68290100 0x02 0x5122901 0x00 0x2060029 0x1000000 0x20720 0x29010000 0x208 0x1290100 0x02 0x9002901 0x00 0x212ab29 0x1000000 0x2157b 0x29010000 0x216 0xa290100 0x02 0x30ff2901 0x00 0x231fe29 0x1000000 0x232fc 0x29010000 0x233 0xfa290100 0x02 0x34f82901 0x00 0x235f629 0x1000000 0x236f4 0x29010000 0x237 0xf2290100 0x02 0x38f12901 0x00 0x239f029 0x1000000 0x23aef 0x29010000 0x23b 0xed290100 0x02 0x3deb2901 0x00 0x23fe929 0x1000000 0x240e7 0x29010000 0x241 0xe5290100 0x02 0x45ff2901 0x00 0x246fc29 0x1000000 0x247f6 0x29010000 0x248 0xec290100 0x02 0x49df2901 0x00 0x24acd29 0x1000000 0x24bc0 0x29010000 0x24c 0xb3290100 0x02 0x4da62901 0x00 0x24e9829 0x1000000 0x24f8f 0x29010000 0x250 0x86290100 0x02 0x517d2901 0x00 0x2527429 0x1000000 0x2536d 0x29010000 0x254 0x66290100 0x02 0x58ff2901 0x00 0x259fd29 0x1000000 0x25af9 0x29010000 0x25b 0xf2290100 0x02 0x5cec2901 0x00 0x25de629 0x1000000 0x25ede 0x29010000 0x25f 0xd9290100 0x02 0x60d22901 0x00 0x261cc29 0x1000000 0x262c7 0x29010000 0x263 0xc3290100 0x02 0x64be2901 0x00 0x265b929 0x1000000 0x266b5 0x29010000 0x267 0xb3290100 0x02 0xff222901 0x00 0x2fb0129 0x1000000 0x20104 0x29010000 0x202 0x8290100 0x02 0x30c2901 0x00 0x2041029 0x1000000 0x20514 0x29010000 0x206 0x18290100 0x02 0x7202901 0x00 0x2082429 0x1000000 0x20928 0x29010000 0x20a 0x30290100 0x02 0xb382901 0x00 0x20c3829 0x1000000 0x20d30 0x29010000 0x20e 0x28290100 0x02 0xf202901 0x00 0x2101029 0x1000000 0x21100 0x29010000 0x212 0x290100 0x02 0x13002901 0x00 0x21a0029 0x1000000 0x21b00 0x29010000 0x21c 0x4290100 0x02 0x1d082901 0x00 0x21e0c29 0x1000000 0x21f10 0x29010000 0x220 0x14290100 0x02 0x21182901 0x00 0x2222029 0x1000000 0x22318 0x29010000 0x224 0x10290100 0x02 0x25082901 0x00 0x2260029 0x1000000 0x22700 0x29010000 0x228 0x290100 0x02 0x29002901 0x00 0x22a0029 0x1000000 0x22b00 0x29010000 0x22f 0x290100 0x02 0x30002901 0x00 0x2311029 0x1000000 0x2329c 0x29010000 0x233 0x94290100 0x02 0x34942901 0x00 0x2351e29 0x1000000 0x23614 0x29010000 0x237 0x1e290100 0x02 0x381e2901 0x00 0x2391429 0x1000000 0x23a0a 0x29010000 0x23b 0xc290100 0x02 0x3f0e2901 0x00 0x2401529 0x1000000 0x2411b 0x29010000 0x242 0x20290100 0x02 0x43262901 0x00 0x2441e29 0x1000000 0x24517 0x29010000 0x246 0xf290100 0x02 0x47082901 0x00 0x2480a29 0x1000000 0x24912 0x29010000 0x24a 0x23290100 0x02 0x4b282901 0x00 0x24c9c29 0x1000000 0x24d00 0x29010000 0x253 0x290100 0x02 0x54002901 0x00 0x2550029 0x1000000 0x25676 0x29010000 0x268 0x76290100 0x02 0xa2202901 0x00 0x2ff2629 0x1000000 0x2fb01 0x29010000 0x245 0xe290100 0x02 0xff102901 0x00 0x2fb0129 0x1000000 0x25580 0x29010000 0x2ba 0x3290100 0x03 0x510fff29 0x1000000 0x2532c 0x29010000 0x14000229 0x290100 0x640002 0x11002901 0x00 0x2ff2529 0x1000000 0x2fb01 0x29010000 0x224 0xa7290100 0x02 0x46132901 0x00 0x2479429 0x1000000 0x2ff26 0x29010000 0x2fb 0x1290100 0x02 0x31112901 0x00 0x2321829 0x1000000 0x23667>;
		qcom,mdss-dsi-off-command = [
					29 01 00 00 00 00 02 FF 10
					29 01 00 00 00 00 02 FB 01
					29 01 00 00 14 00 02 28 00
					29 01 00 00 78 00 02 10 00
					];
		qcom,mdss-dsi-CABC_UI_on-command = [
					29 00 00 00 00 00 02 ff 10
					29 00 00 00 00 00 02 fb 01
					29 01 00 00 00 00 02 55 81
					];
		qcom,mdss-dsi-CABC_STILL_on-command = [
					29 00 00 00 00 00 02 ff 10
					29 00 00 00 00 00 02 fb 01
					29 01 00 00 00 00 02 55 82
					];
		qcom,mdss-dsi-CABC_MOVIE_on-command = [
					29 00 00 00 00 00 02 ff 10
					29 00 00 00 00 00 02 fb 01
					29 01 00 00 00 00 02 55 83
					];
		qcom,mdss-dsi-CABC_off-command = [
					29 00 00 00 00 00 02 ff 10
					29 00 00 00 00 00 02 fb 01
					29 01 00 00 00 00 02 55 80
					];
		qcom,mdss-dsi-CE_on-command = [
					29 00 00 00 00 00 02 ff 22
					29 00 00 00 00 00 02 fb 01
					29 00 00 00 00 00 02 53 01
					29 01 00 00 00 00 02 54 01
					29 01 00 00 00 00 02 ff 10
					];
		qcom,mdss-dsi-CE_off-command = [
					29 00 00 00 00 00 02 ff 22
					29 00 00 00 00 00 02 fb 01
					29 00 00 00 00 00 02 53 00
					29 01 00 00 00 00 02 54 00
					29 01 00 00 00 00 02 ff 10
					];
		qcom,mdss-dsi-on-command-state = "dsi_lp_mode";
		qcom,mdss-dsi-off-command-state = "dsi_lp_mode";
		qcom,mdss-dsi-h-sync-pulse = <1>;
		qcom,mdss-dsi-traffic-mode = "burst_mode";
		qcom,mdss-dsi-lane-map = "lane_map_0123";
		qcom,mdss-dsi-bllp-eof-power-mode;
		qcom,mdss-dsi-bllp-power-mode;
		qcom,mdss-dsi-lane-0-state;
		qcom,mdss-dsi-lane-1-state;
		qcom,mdss-dsi-lane-2-state;
		qcom,mdss-dsi-lane-3-state;
		/delete-property/ qcom,mdss-dsi-panel-timings;
		qcom,mdss-dsi-panel-timings-phy-12nm = [
					0b 07 06 03 00 05 03 09];
		qcom,mdss-dsi-t-clk-post = <0x60>;
		qcom,mdss-dsi-t-clk-pre = <0x06>;
		qcom,mdss-dsi-bl-min-level = <1>;
		qcom,mdss-dsi-bl-max-level = <2047>;
		qcom,mdss-brightness-max-level = <2047>;
		qcom,mdss-brightness-max-level-factory = <255>;
		qcom,mdss-dsi-bl-pmic-control-type = "bl_mount";
		qcom,panel-supply-entries = <&dsi_panel_pwr_supply>;
		qcom,mdss-dsi-reset-sequence = <1 20>, <0 10>, <1 20>;
		qcom,esd-check-enabled;
		qcom,mdss-dsi-panel-status-command = [06 01 00 01 05 00 01 0A];
		qcom,mdss-dsi-panel-status-command-mode = "dsi_lp_mode";
		qcom,mdss-dsi-panel-status-check-mode = "reg_read";
		qcom,mdss-dsi-panel-status-read-length = <1>;
		qcom,mdss-dsi-panel-status-valid-params = <1>;
		qcom,mdss-dsi-panel-status-value = <0x9C>;
		qcom,mdss-dsi-panel-max-error-count = <3>;
		qcom,mdss-pan-physical-width-dimension = <68>;
		qcom,mdss-pan-physical-height-dimension = <143>;
	};
};
